&i2c1 {
    status = "okay";  /* Enable the I2C1 controller */

    eeprom@58 {
        compatible = "atmel,24mac402";
        reg = <0x58>;  /* I2C address of the EEPROM */
        pagesize = <16>;
        size = <256>;  /* EEPROM size */
        address-width = <8>;
        num-addresses = <1>;

        eth0_addr: eth-mac-addr@9A {
            reg = <0x9A 0x06>;
        };
    };
};