## conf/machine/zub.conf
```bitbake
#### Preamble
MACHINEOVERRIDES =. "${@['', 'zuboard:']['zuboard' != '${MACHINE}']}"
#### Regular settings follow

require conf/machine/zynqmp-generic.conf


DISTRO_FEATURES:append = " openamp"
IMAGE_INSTALL:append = " open-amp libmetal open-amp-device-tree"

#### No additional settings should be after the Postamble
#### Postamble
PACKAGE_EXTRA_ARCHS:append = "${@['', ' zuboard']['zuboard' != "${MACHINE}"]}"
```
